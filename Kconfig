## Kconfig
```kconfig
menu "espure Configuration"

    menu "Locale Selection"
        comment "Select locales to include in build"
        comment "Each locale adds memory to the binary"

        config ESPURE_LOCALE_DE_DE
            bool "German Dictionary (de-DE)"
            default y
            help
                Include the German (Germany) locale dictionary and phoneme rules.
                Size: ~764 KB (compressed) or ~1.5 MB (binary array)

        config ESPURE_LOCALE_EN_GB
            bool "British English Architecture Pilot (en-GB)"
            default n
            help
                Include a small English pronunciation pilot. This is not full
                English support and does not provide English fallback rules.

    endmenu

    choice
        prompt "Dictionary Storage Mode"
        default ESPURE_DICT_BINARY_ARRAY
        help
            Select how the dictionary is stored in flash and memory.
            
            - Binary Array: Very fast binary search, but requires ~1.5MB for German. Best if PSRAM is available.
            - Huffman Trie: Highly compressed, parses on-the-fly. Minimal RAM, saves Flash space. Best for ESP32 Classic.

        config ESPURE_DICT_BINARY_ARRAY
            bool "Flat Binary Array (Fastest)"

        config ESPURE_DICT_HUFFMAN_TRIE
            bool "Compressed Huffman Trie (Low Memory)"
    endchoice

endmenu
```

## examples/console_espure/sdkconfig.defaults
```kconfig
CONFIG_IDF_TARGET="esp32p4"
CONFIG_ESP32P4_SELECTS_REV_LESS_V3=y

CONFIG_ESPTOOLPY_FLASHMODE_QIO=y
CONFIG_ESPTOOLPY_FLASHSIZE_32MB=y

CONFIG_SPIRAM=y
CONFIG_SPIRAM_USE_MALLOC=y
CONFIG_SPIRAM_MALLOC_ALWAYSINTERNAL=16384
CONFIG_SPIRAM_MALLOC_RESERVE_INTERNAL=32768
CONFIG_SPIRAM_SPEED_200M=y
CONFIG_SPIRAM_MODE_OCT=y
CONFIG_SPIRAM_ECC_ENABLE=n

CONFIG_ESP_CONSOLE_UART_DEFAULT=y
CONFIG_ESP_CONSOLE_SECONDARY_NONE=y
CONFIG_ESP_CONSOLE_UART_BAUDRATE=115200

CONFIG_ESPURE_LOCALE_DE_DE=y
CONFIG_ESPURE_LOCALE_EN_GB=y
CONFIG_ESPURE_DICT_HUFFMAN_TRIE=y

CONFIG_PARTITION_TABLE_CUSTOM=y
CONFIG_PARTITION_TABLE_CUSTOM_FILENAME="partitions.csv"
CONFIG_PARTITION_TABLE_FILENAME="partitions.csv"
```

## examples/console_espure_dev/sdkconfig.defaults
```kconfig
CONFIG_IDF_TARGET="esp32p4"
CONFIG_ESP32P4_SELECTS_REV_LESS_V3=y

CONFIG_ESPTOOLPY_FLASHMODE_QIO=y
CONFIG_ESPTOOLPY_FLASHSIZE_32MB=y

CONFIG_SPIRAM=y
CONFIG_SPIRAM_USE_MALLOC=y
CONFIG_SPIRAM_MALLOC_ALWAYSINTERNAL=16384
CONFIG_SPIRAM_MALLOC_RESERVE_INTERNAL=32768
CONFIG_SPIRAM_SPEED_200M=y
CONFIG_SPIRAM_MODE_OCT=y
CONFIG_SPIRAM_ECC_ENABLE=n

CONFIG_ESP_CONSOLE_UART_DEFAULT=y
CONFIG_ESP_CONSOLE_SECONDARY_NONE=y
CONFIG_ESP_CONSOLE_UART_BAUDRATE=115200

CONFIG_ESPURE_LOCALE_DE_DE=y
CONFIG_ESPURE_LOCALE_EN_GB=y
CONFIG_ESPURE_DICT_HUFFMAN_TRIE=y

CONFIG_PARTITION_TABLE_CUSTOM=y
CONFIG_PARTITION_TABLE_CUSTOM_FILENAME="partitions.csv"
CONFIG_PARTITION_TABLE_FILENAME="partitions.csv"

CONFIG_UART_FILEBRIDGE_NUM=1
CONFIG_UART_FILEBRIDGE_TX_PIN=30
CONFIG_UART_FILEBRIDGE_RX_PIN=31
CONFIG_UART_FILEBRIDGE_RTS_PIN=50
CONFIG_UART_FILEBRIDGE_CTS_PIN=29
CONFIG_UART_FILEBRIDGE_BAUD=3000000
CONFIG_UART_FILEBRIDGE_SD_MOUNT_OWN=y
CONFIG_UART_FILEBRIDGE_BACKEND_LITTLEFS=n
CONFIG_UART_FILEBRIDGE_BACKEND_SPIFFS=n
CONFIG_UART_FILEBRIDGE_BACKEND_FLASH_FAT=n
```

## test/sdkconfig.defaults
```kconfig
# ============================================================================
# ESP32-P4 Hardware Target Configuration
# ============================================================================
CONFIG_IDF_TARGET="esp32p4"
CONFIG_ESP32P4_SELECTS_REV_LESS_V3=y

# ============================================================================
# Flash Configuration (32 MB QIO Mode)
# ============================================================================
CONFIG_ESPTOOLPY_FLASHMODE_QIO=y
CONFIG_ESPTOOLPY_FLASHSIZE_32MB=y

# ============================================================================
# PSRAM Configuration (Required for ASR models)
# ============================================================================
CONFIG_SPIRAM=y
CONFIG_SPIRAM_USE_MALLOC=y
CONFIG_SPIRAM_MALLOC_ALWAYSINTERNAL=16384
CONFIG_SPIRAM_MALLOC_RESERVE_INTERNAL=32768
CONFIG_SPIRAM_SPEED_200M=y
CONFIG_SPIRAM_MODE_OCT=y
CONFIG_SPIRAM_ECC_ENABLE=n

# ============================================================================
# SPIFFS Configuration (16MB partition requires larger page size)
# ============================================================================
CONFIG_SPIFFS_MAX_PARTITIONS=3
CONFIG_SPIFFS_PAGE_SIZE=512
CONFIG_SPIFFS_OBJ_NAME_LEN=64
CONFIG_SPIFFS_USE_MAGIC=y
CONFIG_SPIFFS_USE_MAGIC_LENGTH=y


# ============================================================================
# espure Language Selection
# ============================================================================
CONFIG_ESPURE_LANG_EN=y
CONFIG_ESPURE_LANG_DE=y
```
